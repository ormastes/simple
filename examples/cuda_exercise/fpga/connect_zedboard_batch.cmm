; ZedBoard (Zynq-7020) Connection Test - Batch Mode
; Connects via JTAG through Lauterbach Power Debug II
; Outputs results to file and exits

SYStem.RESet

SYStem.CPU ZYNQ-7000

; DAP configuration for ZedBoard JTAG chain
SYStem.CONFIG DAPIRPRE 6.
SYStem.CONFIG DAPIRPOST 0.
SYStem.CONFIG DAPDRPRE 1.
SYStem.CONFIG DAPDRPOST 0.

TRONCHIP.SET UNDEF OFF
TRONCHIP.SET DABORT OFF
TRONCHIP.SET PABORT OFF

; Connect to target
SYStem.UP

; Write results to log file
OPEN #1 /home/ormastes/dev/pub/simple/examples/cuda_exercise/fpga/jtag_result.txt /Create
WRITE #1 "JTAG Connection Test"
WRITE #1 "CPU: " SYStem.CPU()
WRITE #1 "State: " SYStem.STATE()
CLOSE #1

; Quit T32
QUIT
