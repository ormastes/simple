; ZedBoard (Zynq-7020) Connection Test
; Connects via JTAG through Lauterbach Power Debug II

SYStem.RESet

SYStem.CPU ZYNQ-7000

; DAP configuration for ZedBoard JTAG chain
; (FPGA TAP is before ARM DAP in chain)
SYStem.CONFIG DAPIRPRE 6.
SYStem.CONFIG DAPIRPOST 0.
SYStem.CONFIG DAPDRPRE 1.
SYStem.CONFIG DAPDRPOST 0.

; Disable exception trapping during connect
TRONCHIP.SET UNDEF OFF
TRONCHIP.SET DABORT OFF
TRONCHIP.SET PABORT OFF

; Connect to target
SYStem.UP

; Print connection status
PRINT "ZedBoard JTAG connection established"
PRINT "CPU: " SYStem.CPU()
PRINT "State: " SYStem.STATE()

; Show JTAG chain
SYStem.DETECT

ENDDO
