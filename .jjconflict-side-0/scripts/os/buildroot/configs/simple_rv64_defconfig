## .jjconflict-side-0/scripts/os/buildroot/configs/simple_rv64_defconfig
```kconfig
BR2_riscv=y
BR2_riscv_custom=y
BR2_RISCV_64=y
BR2_RISCV_ISA_RVM=y
BR2_RISCV_ISA_RVA=y
BR2_RISCV_ISA_RVC=y
BR2_RISCV_USE_MMU=y
BR2_RISCV_ABI_LP64=y
BR2_TOOLCHAIN_BUILDROOT=y
BR2_TOOLCHAIN_BUILDROOT_UCLIBC=y
BR2_STATIC_LIBS=y
BR2_INIT_BUSYBOX=y
BR2_PACKAGE_BUSYBOX=y
BR2_PACKAGE_BUSYBOX_CONFIG_FRAGMENT_FILES="$(BR2_EXTERNAL_SIMPLE_RISCV_PATH)/board/simple-riscv/busybox.fragment"
BR2_TARGET_GENERIC_ROOT_PASSWD=""
BR2_TARGET_GENERIC_GETTY=y
BR2_TARGET_GENERIC_GETTY_PORT="ttyS0"
BR2_TARGET_GENERIC_GETTY_BAUDRATE_115200=y
BR2_TARGET_GENERIC_GETTY_TERM="vt100"
BR2_TARGET_ROOTFS_CPIO=y
BR2_TARGET_ROOTFS_CPIO_GZIP=y
BR2_ROOTFS_OVERLAY="$(BR2_EXTERNAL_SIMPLE_RISCV_PATH)/board/simple-riscv/overlay"
BR2_REPRODUCIBLE=y
```
